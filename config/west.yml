## config/west.yml
```yaml
manifest:
  remotes:
    - name: zmkfirmware
      url-base: https://github.com/zmkfirmware
    - name: dhruvinsh
      url-base: https://github.com/dhruvinsh
    - name: caksoylar # Status LED
      url-base: https://github.com/caksoylar
  projects:
    - name: zmk
      remote: zmkfirmware
      revision: v0.3.0
      import: app/west.yml
    - name: zmk-tri-state
      remote: dhruvinsh
      revision: main
      # See: https://github.com/caksoylar/zmk-rgbled-widget
    - name: zmk-rgbled-widget # Status LED
      remote: caksoylar
      revision: main
  self:
    path: config
```
